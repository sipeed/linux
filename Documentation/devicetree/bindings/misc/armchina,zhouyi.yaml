## Documentation/devicetree/bindings/misc/armchina,zhouyi.yaml
```yaml
# SPDX-License-Identifier: GPL-2.0-only
%YAML 1.2
---
$id: http://devicetree.org/schemas/misc/armchina,zhouyi.yaml#
$schema: http://devicetree.org/meta-schemas/core.yaml#

title: ARM China Zhouyi AIPU

maintainers:
  - Icenowy Zheng <icenowy@sipeed.com>

properties:
  compatible:
    - items:
        - const: allwinner,sun50i-r329-zhouyi
        - const: armchina,zhouyi-v1

  reg:
    maxItems: 1

  interrupts:
    maxItems: 1

  clocks:
    minItems: 2

  clock-names:
    additionalItems: true
    items:
      - const: core
      - const: bus

  memory-region: true

  assigned-clocks: true

  assigned-clock-rates: true

  assigned-clock-parents: true

  resets:
    maxItems: 1

required:
  - compatible
  - reg
  - interrupts
  - clocks
  - clock-names

additionalProperties: false

allOf:
  - if:
      properties:
        compatible:
          contains:
            enum:
              - allwinner,sun50i-r329-zhouyi
    then:
      properties:
        clock-names:
          additionalItems: false
          items:
            - const: core
            - const: bus
            - const: mbus

      required:
        - resets

examples:
  - |
    #include <dt-bindings/interrupt-controller/irq.h>
    #include <dt-bindings/interrupt-controller/arm-gic.h>

    mali: gpu@1c40000 {
      compatible = "allwinner,sun7i-a20-mali", "arm,mali-400";
      reg = <0x01c40000 0x10000>;
      interrupts = <GIC_SPI 97 IRQ_TYPE_LEVEL_HIGH>,
             <GIC_SPI 98 IRQ_TYPE_LEVEL_HIGH>,
             <GIC_SPI 99 IRQ_TYPE_LEVEL_HIGH>,
             <GIC_SPI 100 IRQ_TYPE_LEVEL_HIGH>,
             <GIC_SPI 102 IRQ_TYPE_LEVEL_HIGH>,
             <GIC_SPI 103 IRQ_TYPE_LEVEL_HIGH>,
             <GIC_SPI 101 IRQ_TYPE_LEVEL_HIGH>;
      interrupt-names = "gp",
            "gpmmu",
            "pp0",
            "ppmmu0",
            "pp1",
            "ppmmu1",
            "pmu";
      clocks = <&ccu 1>, <&ccu 2>;
      clock-names = "bus", "core";
      resets = <&ccu 1>;
      #cooling-cells = <2>;
    };

...
```

## Documentation/devicetree/bindings/phy/allwinner,sun50i-r329-usb-phy.yaml
```yaml
# SPDX-License-Identifier: GPL-2.0
%YAML 1.2
---
$id: http://devicetree.org/schemas/phy/allwinner,sun50i-r329-usb-phy.yaml#
$schema: http://devicetree.org/meta-schemas/core.yaml#

title: Allwinner R329 USB PHY Device Tree Bindings

maintainers:
  - Chen-Yu Tsai <wens@csie.org>
  - Maxime Ripard <mripard@kernel.org>

properties:
  "#phy-cells":
    const: 1

  compatible:
    const: allwinner,sun50i-r329-usb-phy

  reg:
    items:
      - description: PHY Control registers
      - description: PHY PMU0 registers
      - description: PHY PMU1 registers

  reg-names:
    items:
      - const: phy_ctrl
      - const: pmu0
      - const: pmu1

  clocks:
    items:
      - description: USB OTG PHY bus clock
      - description: USB Host PHY bus clock

  clock-names:
    items:
      - const: usb0_phy
      - const: usb1_phy

  resets:
    items:
      - description: USB OTG reset
      - description: USB Host Controller reset

  reset-names:
    items:
      - const: usb0_reset
      - const: usb1_reset

  usb0_id_det-gpios:
    maxItems: 1
    description: GPIO to the USB OTG ID pin

  usb0_vbus_det-gpios:
    maxItems: 1
    description: GPIO to the USB OTG VBUS detect pin

  usb0_vbus_power-supply:
    description: Power supply to detect the USB OTG VBUS

  usb0_vbus-supply:
    description: Regulator controlling USB OTG VBUS

  usb3_vbus-supply:
    description: Regulator controlling USB3 Host controller

required:
  - "#phy-cells"
  - compatible
  - clocks
  - clock-names
  - reg
  - reg-names
  - resets
  - reset-names

additionalProperties: false

examples:
  - |
    #include <dt-bindings/gpio/gpio.h>
    #include <dt-bindings/clock/sun50i-r329-ccu.h>
    #include <dt-bindings/reset/sun50i-r329-ccu.h>

    usbphy: phy@4100400 {
        compatible = "allwinner,sun50i-r329-usb-phy";
        reg = <0x04100400 0x24>,
              <0x04101800 0x4>,
              <0x04201800 0x4>;
        reg-names = "phy_ctrl",
                    "pmu0",
                    "pmu1";
        clocks = <&ccu CLK_USB_PHY0>,
                 <&ccu CLK_USB_PHY1>;
        clock-names = "usb0_phy",
                      "usb1_phy";
        resets = <&ccu RST_USB_PHY0>,
                 <&ccu RST_USB_PHY1>;
        reset-names = "usb0_reset",
                      "usb1_reset";
        status = "disabled";
        #phy-cells = <1>;
    };
```

## Documentation/devicetree/bindings/pwm/allwinner,sun50i-r329-pwm.yaml
```yaml
# SPDX-License-Identifier: GPL-2.0
%YAML 1.2
---
$id: http://devicetree.org/schemas/pwm/allwinner,sun50i-r329-pwm.yaml#
$schema: http://devicetree.org/meta-schemas/core.yaml#

title: Allwinner R329 PWM Device Tree Bindings

maintainers:
  - Chen-Yu Tsai <wens@csie.org>
  - Maxime Ripard <mripard@kernel.org>

properties:
  "#pwm-cells":
    const: 3

  compatible:
    oneOf:
      - const: allwinner,sun50i-r329-pwm
      - const: allwinner,sun5i-a10s-pwm
      - const: allwinner,sun5i-a13-pwm
      - const: allwinner,sun7i-a20-pwm
      - const: allwinner,sun8i-h3-pwm
      - items:
          - const: allwinner,sun8i-a83t-pwm
          - const: allwinner,sun8i-h3-pwm
      - items:
          - const: allwinner,sun8i-v3s-pwm
          - const: allwinner,sun7i-a20-pwm
      - items:
          - const: allwinner,sun50i-a64-pwm
          - const: allwinner,sun5i-a13-pwm
      - items:
          - const: allwinner,sun50i-h5-pwm
          - const: allwinner,sun5i-a13-pwm
      - const: allwinner,sun50i-h6-pwm

  reg:
    maxItems: 1

  clocks:
    minItems: 2
    items:
      - description: Bus Clock
      - description: 24M Oscillator Clock

  clock-names: true

  resets:
    maxItems: 1

  allwinner,pwm-channels:
    type: uint32
    description:
      The number of PWM channels provided by this PWM controller.

required:
  - "#pwm-cells"
  - compatible
  - reg
  - clocks
  - clock-names
  - resets
  - allwinner,pwm-channels

additionalProperties: false

examples:
  - |
    #include <dt-bindings/clock/sun50i-r329-ccu.h>
    #include <dt-bindings/reset/sun50i-r329-ccu.h>
    pwm: pwm@2000c00 {
        compatible = "allwinner,sun50i-r329-pwm";
        reg = <0x02000c00 0x400>;
        clocks = <&ccu CLK_BUS_PWM>, <&osc24M>;
        clock-names = "bus", "hosc";
        resets = <&ccu RST_BUS_PWM>;
        allwinner,pwm-channels = <9>;
        #pwm-cells = <3>;
    };

...
```

## Documentation/devicetree/bindings/sound/allwinner,sun50i-r329-codec-analog.yaml
```yaml
# SPDX-License-Identifier: GPL-2.0
%YAML 1.2
---
$id: http://devicetree.org/schemas/sound/allwinner,sun50i-r329-codec-analog.yaml#
$schema: http://devicetree.org/meta-schemas/core.yaml#

title: Allwinner R329 Analog Codec Device Tree Bindings

maintainers:
  - Chen-Yu Tsai <wens@csie.org>
  - Maxime Ripard <mripard@kernel.org>

properties:
  compatible:
    const: allwinner,sun50i-r329-codec-analog

  reg:
    maxItems: 1

required:
  - compatible
  - reg

additionalProperties: false

examples:
  - |
    codec_analog: codec-analog@7032300 {
      compatible = "allwinner,sun50i-r329-codec-analog";
      reg = <0x07032300 0xd00>;
    };

...
```

## drivers/staging/aipu/Kconfig
```kconfig
config ZHOUYI_AIPU
	tristate "Zhouyi AIPU support"
	depends on OF_IRQ
	depends on OF_RESERVED_MEM
	help
	  Driver for Zhouyi AIPU.
```
